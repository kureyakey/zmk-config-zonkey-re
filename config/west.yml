## config/west.yml
```yaml
manifest:
  remotes:
    - name: zmkfirmware
      url-base: https://github.com/zmkfirmware
    - name: caksoylar
      url-base: https://github.com/caksoylar
    - name: badjeff
      url-base: https://github.com/badjeff
    - name: te9no
      url-base: https://github.com/te9no
    - name: englmaxi
      url-base: https://github.com/englmaxi
    - name: zettaface
      url-base: https://github.com/zettaface
    - name: kot149
      url-base: https://github.com/kot149
    - name: prospector
      url-base: https://github.com/t-ogura
    - name: cormoran
      url-base: https://github.com/cormoran
    - name: efogdev
      url-base: https://github.com/efogdev
    - name: yamaryu211
      url-base: https://github.com/yamaryu211
  projects:
    - name: zmk
      remote: cormoran
      revision: v0.3+custom-studio-protocol
      import: app/west.yml
    - name: zmk-rgbled-widget
      remote: caksoylar
      revision: v0.3
    - name: zmk-pmw3610-driver
      remote: efogdev
      revision: main
    - name: zmk-analog-input-driver
      remote: badjeff
      revision: main
    - name: zmk-module-analoginput-rpc
      remote: te9no
      revision: main
    - name: zmk-dongle-display
      remote: te9no
      revision: main
    - name: zmk-input-processor-keybind
      remote: te9no
      revision: main
    - name: zmk-layout-shift
      remote: kot149
      revision: v1
    - name: zmk-input-processor-temp-layer-threshold
      remote: yamaryu211
      revision: main
    - name: zmk-module-runtime-input-processor
      remote: cormoran
      revision: main
    - name: zmk-module-battery-history
      remote: cormoran
      revision: main
    - name: zmk-module-ble-management
      remote: cormoran
      revision: main
    # zmk-module-settings-rpc は v0.3+custom-studio-protocol と互換性なし
    # ZMK本体が zmk_activity_get/set_idle/sleep_ms を実装したら再度有効化
    # - name: zmk-module-settings-rpc
    #   remote: cormoran
    #   revision: main
    - name: zmk-feature-module-physical-layout
      remote: cormoran
      revision: main
  self:
    path: config
```
